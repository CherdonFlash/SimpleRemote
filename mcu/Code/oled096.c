#include "oled096.h"

#define OLED_ADDR 0x78  // OLED 7位地址=0x3C 左移1位变为0x78（常见0.96寸SSD1306）  
uint8_t OLED_GRAM[8][128]; // 8页 × 128列，页寻址
//行64 列128 像素 
//页寻址模式:
//每8行像素为1页 64行分为8页 
//每次从第0页第0列扫描到第0页的第127列 然后页地址++ 再从下一页开始扫描  （每一页里面又是从第0列扫描到第127列）
//一个字节就可以控制垂直的八个像素
//顺序是先从左往右 再从上往下

//简单解释 oled 0.96寸的通信 一般只有两个寄存器地址一个是0x00 一个是0x40
//只需要往前者这个地址写一个字节的数据 oled就会接受这个数据然后执行操作 每次写一次就执行一次 所以是每个值代表一个操作 
void OLED_Init(void)
{
	OLED_WriteByte(0xAE, 1); // 关闭显示
    OLED_WriteByte(0x20, 1); OLED_WriteByte(0x00, 1); // 设置内存寻址模式为“水平寻址模式”。
    OLED_WriteByte(0xB0, 1);//设置页起始地址为0（第0页）。
    OLED_WriteByte(0xC8, 1);//设置COM扫描方向为从COM[N-1]到COM0，垂直翻转显示。
    OLED_WriteByte(0x00, 1);//设置列起始地址低4位为0。
    OLED_WriteByte(0x10, 1);//设置列起始地址高4位为0。
    OLED_WriteByte(0x40, 1);//设置显示起始行地址为0。
    OLED_WriteByte(0x81, 1); OLED_WriteByte(0x7F, 1);//设置对比度为0x7F（中等亮度）。
    OLED_WriteByte(0xA1, 1);//段重映射，左右镜像。
    OLED_WriteByte(0xA6, 1);//正常显示模式。
    OLED_WriteByte(0xA8, 1); OLED_WriteByte(0x3F, 1);//MUX比率设置为63（对应64行）。
    OLED_WriteByte(0xA4, 1);//	按显存显示（正常）
    OLED_WriteByte(0xD3, 1); OLED_WriteByte(0x00, 1);//显示偏移设置为0。
    OLED_WriteByte(0xD5, 1); OLED_WriteByte(0x80, 1);//设置时钟分频为默认值。
    OLED_WriteByte(0xD9, 1); OLED_WriteByte(0xF1, 1);//预充电周期设置。
    OLED_WriteByte(0xDA, 1); OLED_WriteByte(0x12, 1);//COM引脚硬件配置
    OLED_WriteByte(0xDB, 1); OLED_WriteByte(0x40, 1);//VCOMH电压设置。
    OLED_WriteByte(0x8D, 1); OLED_WriteByte(0x14, 1);//开启电荷泵
    OLED_WriteByte(0xAF, 1); // 打开显示

}

//往oled一个寄存器写一个字节指令/数据
void OLED_WriteByte(uint8_t byte, uint8_t cmd)
{
	//如果形参cmd是1代表写命令 0代表写数据
    if (cmd)
        IIC_WriteReg(OLED_ADDR, 0x00, byte);  // 0x00 表示命令控制字
    else
        I2C1_DMA_Write(OLED_ADDR, 0x40, &byte, 1);
}
//设置 OLED 接下来要写入的起始位置（列 x，页 y），以便将显示数据写到屏幕的指定位置。
void OLED_SetPos(uint8_t x, uint8_t y)
{
    OLED_WriteByte(0xB0 + y, 1);                  // 页地址
    OLED_WriteByte(0x00 + (x & 0x0F), 1);         // 列地址低4位
    OLED_WriteByte(0x10 + ((x >> 4) & 0x0F), 1);  // 列地址高4位
}
// 显示一个 8x16 的 ASCII 字符，x: 列(0~127)，y: 页(0~7)，y 每次 +2 是移动16像素
void OLED_ShowChar(uint8_t x, uint8_t y, char chr)
{
    if (x > 127 || y > 7) return;          // 越界保护，y是像素坐标(0~63)
    if (chr < 32 || chr > 126) return;     // 非ASCII可见字符范围

    uint8_t c = chr - 32;                  // 字符索引
    const uint8_t *data = ASCII816[c];     // 字符点阵数据（16×8像素）

    // 字符宽度 = 8，高度 = 16
    for (uint8_t col = 0; col < 8; col++) {
        uint8_t upper = data[col];         // 上 8 行
        uint8_t lower = data[col + 8];     // 下 8 行

        for (uint8_t row = 0; row < 8; row++) {
            uint8_t pixel = (upper >> row) & 0x01;
            OLED_DrawPixel(x + col, y + row, pixel);
        }
        for (uint8_t row = 0; row < 8; row++) {
            uint8_t pixel = (lower >> row) & 0x01;
            OLED_DrawPixel(x + col, y + 8 + row, pixel);
        }
    }
}

// 显示字符串，从指定列x和页y开始显示，字符串以'\0'结尾
void OLED_ShowString(uint8_t x, uint8_t y, const char *str)
{
    while (*str != '\0' && x <= 120)  // 每次写8列，确保不越界
    {
        OLED_ShowChar(x, y, *str);
        x += 8;
        str++;
    }
}
// 显示整数（正负都支持）
void OLED_ShowInt(uint8_t x, uint8_t y, int num)
{
    char buf[12];  // 最多支持 "-2147483648"（11字符 + '\0'）
    sprintf(buf, "%d", num);
    OLED_ShowString(x, y, buf);
}
//显示汉字 16*16
void OLED_ShowChinese(uint8_t x, uint8_t y, const uint8_t hz[2][16])
{
    // 参数说明：
    // x：起始列（0~127）
    // y：起始页（0~7），一个汉字占2页（上下）

    if (x > 112 || y > 6) return; // 防止越界

    // 显示上半部分（第 y 页）
    OLED_SetPos(x, y);
    for (int i = 0; i < 16; i++) {
        OLED_WriteByte(hz[0][i], 0);
    }

    // 显示下半部分（第 y+1 页）
    OLED_SetPos(x, y + 1);
    for (int i = 0; i < 16; i++) {
        OLED_WriteByte(hz[1][i], 0);
    }
}
// 设置某个像素 (x,y)，color: 1=点亮, 0=熄灭
void OLED_DrawPixel(uint8_t x, uint8_t y, uint8_t color)
{
    if (x >= 128 || y >= 64) return; // 越界保护

    uint8_t page = y / 8;
    uint8_t bit = y % 8;

    if (color)
        OLED_GRAM[page][x] |= (1 << bit);
    else
        OLED_GRAM[page][x] &= ~(1 << bit);
}
//将缓冲区内容写入 OLED：
uint8_t OLED_Refresh(void)
{

//    for (uint8_t page = 0; page < 8; page++) {
//        OLED_SetPos(0, page);  // 设置当前页起始地址
//        I2C1_DMA_Write(OLED_ADDR, 0x40, OLED_GRAM[page], 128);  // 一次写整页数据
//    }
	//OLED_DMA_RefreshFullScreen(OLED_ADDR, OLED_GRAM);
	return OLED_DMA_RefreshFullScreen();
}
// 画矩形函数，增加fill参数，fill=1填充，fill=0只画边框
void OLED_DrawRectangle(uint8_t x0, uint8_t y0, uint8_t x1, uint8_t y1, uint8_t fill)
{
    if (fill) {
        for (uint8_t y = y0; y <= y1; y++) {
            for (uint8_t x = x0; x <= x1; x++) {
                OLED_DrawPixel(x, y, 1);  // 填充所有像素
            }
        }
    } else {
        // 先清空区域
        for (uint8_t y = y0; y <= y1; y++) {
            for (uint8_t x = x0; x <= x1; x++) {
                OLED_DrawPixel(x, y, 0);  // 清除整个矩形区域
            }
        }
        // 再画边框
        for (uint8_t x = x0; x <= x1; x++) {
            OLED_DrawPixel(x, y0, 1); // 顶边
            OLED_DrawPixel(x, y1, 1); // 底边
        }
        for (uint8_t y = y0; y <= y1; y++) {
            OLED_DrawPixel(x0, y, 1); // 左边
            OLED_DrawPixel(x1, y, 1); // 右边
        }
    }
}
// 画水平线段，从(x_start, y)画到(x_end, y)
void OLED_DrawLine(uint8_t x_start, uint8_t x_end, uint8_t y)
{
    for (uint8_t x = x_start; x <= x_end; x++)
    {
        OLED_DrawPixel(x, y, 1);
    }
}
// 画圆函数，增加fill参数，fill=1填充，fill=0只画边缘
void OLED_DrawCircle(uint8_t x0, uint8_t y0, uint8_t r, uint8_t fill)
{
    int x = 0, y = r;
    int d = 3 - 2 * r;

    if (fill) {
        while (x <= y)
        {
            OLED_DrawLine(x0 - x, x0 + x, y0 - y);
            OLED_DrawLine(x0 - y, x0 + y, y0 - x);
            OLED_DrawLine(x0 - y, x0 + y, y0 + x);
            OLED_DrawLine(x0 - x, x0 + x, y0 + y);

            if (d < 0)
                d += 4 * x + 6;
            else {
                d += 4 * (x - y) + 10;
                y--;
            }
            x++;
        }
    } else {
        // 先清除圆内部区域
        for (int dy = -r; dy <= r; dy++) {
            for (int dx = -r; dx <= r; dx++) {
                if (dx*dx + dy*dy <= r*r) {
                    OLED_DrawPixel(x0 + dx, y0 + dy, 0); // 清除像素
                }
            }
        }

        // 再画圆环边缘
        while (x <= y)
        {
            OLED_DrawPixel(x0 + x, y0 + y, 1);
            OLED_DrawPixel(x0 - x, y0 + y, 1);
            OLED_DrawPixel(x0 + x, y0 - y, 1);
            OLED_DrawPixel(x0 - x, y0 - y, 1);
            OLED_DrawPixel(x0 + y, y0 + x, 1);
            OLED_DrawPixel(x0 - y, y0 + x, 1);
            OLED_DrawPixel(x0 + y, y0 - x, 1);
            OLED_DrawPixel(x0 - y, y0 - x, 1);

            if (d < 0)
                d += 4 * x + 6;
            else {
                d += 4 * (x - y) + 10;
                y--;
            }
            x++;
        }
    }
}

// 画射线函数
// x0, y0: 起点坐标
// angle: 角度（度）0度为X正方向，逆时针旋转
// length: 线段长度
void OLED_DrawRay(uint8_t x0, uint8_t y0, float angle, uint8_t length)
{
    float rad = angle * 3.14159265f / 180.0f;  // 角度转弧度
    float dx = cosf(rad);
    float dy = sinf(rad);

    for (uint8_t i = 0; i <= length; i++) {
        int x = x0 + (int)(dx * i + 0.5f);
        int y = y0 + (int)(dy * i + 0.5f);
        OLED_DrawPixel(x, y, 1);
    }
}
//清屏函数
void OLED_Clear(void)
{
    uint8_t page, col;
    for (page = 0; page < 8; page++)  // 8页，高度64像素，每页8像素
    {
        OLED_SetPos(0, page);  // 设置到第page页，第0列
        for (col = 0; col < 128; col++)  // 一页128列
        {
            OLED_WriteByte(0x00, 0);  // 写数据，清零该列像素
        }
    }
}

// ------------------  ASCII字模的数据表 ------------------------ //
const uint8_t ASCII816[95][16] =              // ASCII
{
{0x00,0x00,0x00,0x00,0x00,0x00,0x00,0x00,0x00,0x00,0x00,0x00,0x00,0x00,0x00,0x00},/*" ",0*/

{0x00,0x00,0x00,0xF8,0x00,0x00,0x00,0x00,0x00,0x00,0x00,0x33,0x00,0x00,0x00,0x00},/*"!",1*/
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{0x00,0x02,0x01,0x02,0x02,0x04,0x02,0x00,0x00,0x00,0x00,0x00,0x00,0x00,0x00,0x00},/*"~",94*/



};
